/*
 * i2cMaster.c
 *
 * Created: 2019-04-02 오전 11:34:43
 *  Author: ew2
 */ 

#include "header.h"
#include "extern.h"


void config_i2c_GLCD_Select(void){
	struct port_config pin_config;
	port_get_config_defaults( &pin_config);
	pin_config.direction  = PORT_PIN_DIR_OUTPUT;
	port_pin_set_config(PIN_PA23, &pin_config);
	port_pin_set_output_level(PIN_PA23, true);
}

void configure_i2c_master(void){
	struct i2c_master_config config_i2c_master;
	
	i2c_master_get_config_defaults(&config_i2c_master);
//	config_i2c_master.buffer_timeout = 1000;
	config_i2c_master.buffer_timeout = 10000;
	
	config_i2c_master.pinmux_pad0 = PINMUX_PA08D_SERCOM2_PAD0;
	config_i2c_master.pinmux_pad1 = PINMUX_PA09D_SERCOM2_PAD1;
	
	i2c_master_init(&i2c_master_instance, SERCOM2, &config_i2c_master);
	i2c_master_enable(&i2c_master_instance);
}


enum status_code i2cOut( struct i2c_master_module *const module, uint8_t toSlaveByte){

	SercomI2cm *const i2c_module = &(module->hw->I2CM);
	enum status_code tmp_status;

	if (!(i2c_module->STATUS.reg & SERCOM_I2CM_STATUS_BUSSTATE(2))) return STATUS_ERR_PACKET_COLLISION;

	_i2c_master_wait_for_sync(module);
	
	i2c_module->DATA.reg = toSlaveByte;
	
	tmp_status = _i2c_master_wait_for_bus(module);

	if (tmp_status != STATUS_OK) return tmp_status;
	if (i2c_module->STATUS.reg & SERCOM_I2CM_STATUS_RXNACK) return STATUS_ERR_OVERFLOW;
	
	return STATUS_OK;
}

#define I2C_DATA_SEND_CMD		0x40


uint8_t gLcdInitBytes1[] = {0x00,0x48,0x64,0xA0,0xC8,0x44,0x00,0xAB,0x26,0x81,0x15,0x56,0x64}; //13

uint8_t gLcdInitBytes2[] = {
	0x2F,			// power control 
	0xF3,			// bias save circuit	
	0x00, 
	0x96,			// frc and pwm	
	0x38,			// external mode
	0x75,			// 0x75
	0x97,			// 3frc, 45 pwm 		
	// start 16-level grayscale settings 
	0x80, 0x00,	0x81, 0x00, 0x82, 0x00, 0x83, 0x00, 
	0x84, 0x06, 0x85, 0x06, 0x86, 0x06, 0x87, 0x06, 
	0x88, 0x0B, 0x89, 0x0B, 0x8A, 0x0B, 0x8B, 0x0B, 
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	0x74, 
	0xAF	// display on	
};	// 138

void gLcdInit(void)
{
	uint8_t timeout =0;
	uint8_t i;
		
	i2c_packet.hs_master_code	= 0x0;
	i2c_packet.address			= ADDR_GLCD ;
	i2c_packet.data_length		= 13;
	i2c_packet.data				= gLcdInitBytes1;

	timeout = 0;
	while(i2c_master_write_packet_wait_no_stop(&i2c_master_instance,&i2c_packet) != STATUS_OK ) {
		if(timeout++ > TIMEOUT){
			return;
		}
	}
	delay_us(50);
	i2c_master_write_byte( &i2c_master_instance, 0x2C );
	i2c_master_write_byte( &i2c_master_instance, 0x66 );
	delay_us(50);
	i2c_master_write_byte( &i2c_master_instance, 0x2E );
	delay_us(50);
	for( i = 0 ; i < 138 ; i ++){
		i2c_master_write_byte( &i2c_master_instance, gLcdInitBytes2[i] );
	}
	i2c_master_send_stop( &i2c_master_instance);
}

static enum status_code gLcdDataSend( 
	struct i2c_master_module *const module, struct i2c_master_packet *const packet,uint8_t * pageData )
{
	SercomI2cm *const i2c_module = &(module->hw->I2CM);

	/* Return value. */
	enum status_code tmp_status;
	uint16_t tmp_data_length = packet->data_length;
	uint16_t n;

	_i2c_master_wait_for_sync(module);

	/* Switch to high speed mode */
	if (packet->high_speed) {
		_i2c_master_send_hs_master_code(module, packet->hs_master_code);
	}

	/* Set action to ACK. */
	i2c_module->CTRLB.reg &= ~SERCOM_I2CM_CTRLB_ACKACT;

	/* Set address and direction bit. Will send start command on bus. */
	if (packet->ten_bit_address) {
		i2c_module->ADDR.reg = (packet->address << 1) | I2C_TRANSFER_WRITE |
			(packet->high_speed << SERCOM_I2CM_ADDR_HS_Pos) |
			SERCOM_I2CM_ADDR_TENBITEN;
	} else {
		i2c_module->ADDR.reg = (packet->address << 1) | I2C_TRANSFER_WRITE | (packet->high_speed << SERCOM_I2CM_ADDR_HS_Pos);
//		i2c_module->ADDR.reg = (packet-> address) | I2C_TRANSFER_WRITE |	(packet->high_speed << SERCOM_I2CM_ADDR_HS_Pos);
	}
	/* Wait for response on bus. */
	tmp_status = _i2c_master_wait_for_bus(module);

	/* Check for address response error unless previous error is
	 * detected. */
	if (tmp_status == STATUS_OK) {
		tmp_status = _i2c_master_address_response(module);
	}

	if (tmp_status == STATUS_OK) {
		i2c_master_write_byte ( module, 0x40);   // DataSend
		for(n = 0 ; n < 160 ; n++){
			i2c_master_write_byte ( module, * ( pageData + 159 -n ));
			i2c_master_write_byte ( module, * ( pageData + 159 -n ));
			i2c_master_write_byte ( module, * ( pageData + 159- n ));
			i2c_master_write_byte ( module, * ( pageData + 159 -n ));			
			// ++ pageData;
			delay_us(50);
		}
	}
	i2c_master_send_stop(module);
	return tmp_status;
}

static enum status_code gLcdDataSend2( 
	struct i2c_master_module *const module, struct i2c_master_packet *const packet,uint8_t * pageData )
{
	SercomI2cm *const i2c_module = &(module->hw->I2CM);

	/* Return value. */
	enum status_code tmp_status;
	uint16_t tmp_data_length = packet->data_length;
	uint16_t n;

	_i2c_master_wait_for_sync(module);

	/* Switch to high speed mode */
	if (packet->high_speed) {
		_i2c_master_send_hs_master_code(module, packet->hs_master_code);
	}

	/* Set action to ACK. */
	i2c_module->CTRLB.reg &= ~SERCOM_I2CM_CTRLB_ACKACT;

	/* Set address and direction bit. Will send start command on bus. */
	if (packet->ten_bit_address) {
		i2c_module->ADDR.reg = (packet->address << 1) | I2C_TRANSFER_WRITE |
			(packet->high_speed << SERCOM_I2CM_ADDR_HS_Pos) |
			SERCOM_I2CM_ADDR_TENBITEN;
	} else {
		i2c_module->ADDR.reg = (packet->address << 1) | I2C_TRANSFER_WRITE | (packet->high_speed << SERCOM_I2CM_ADDR_HS_Pos);
//		i2c_module->ADDR.reg = (packet-> address) | I2C_TRANSFER_WRITE |	(packet->high_speed << SERCOM_I2CM_ADDR_HS_Pos);
	}
	/* Wait for response on bus. */
	tmp_status = _i2c_master_wait_for_bus(module);

	/* Check for address response error unless previous error is
	 * detected. */
	if (tmp_status == STATUS_OK) {
		tmp_status = _i2c_master_address_response(module);
	}

	if (tmp_status == STATUS_OK) {
		i2c_master_write_byte ( module, 0x40);   // DataSend
		for(n = 0 ; n < 160 ; n++){
			i2c_master_write_byte ( module, * ( pageData + n ));
			i2c_master_write_byte ( module, * ( pageData + n ));
			i2c_master_write_byte ( module, * ( pageData + n ));
			i2c_master_write_byte ( module, * ( pageData + n ));			
			// ++ pageData;
			delay_us(50);
		}
	}
	i2c_master_send_stop(module);
	return tmp_status;
}

static enum status_code gLcdPageCmd1( struct i2c_master_module *const module, struct i2c_master_packet *const packet,uint8_t pageByte )
{
	SercomI2cm *const i2c_module = &(module->hw->I2CM);

	/* Return value. */
	enum status_code tmp_status;
	uint16_t tmp_data_length = packet->data_length;

	_i2c_master_wait_for_sync(module);

	/* Switch to high speed mode */
	if (packet->high_speed) {
		_i2c_master_send_hs_master_code(module, packet->hs_master_code);
	}

	/* Set action to ACK. */
	i2c_module->CTRLB.reg &= ~SERCOM_I2CM_CTRLB_ACKACT;

	/* Set address and direction bit. Will send start command on bus. */
	if (packet->ten_bit_address) {
		i2c_module->ADDR.reg = (packet->address << 1) | I2C_TRANSFER_WRITE |
			(packet->high_speed << SERCOM_I2CM_ADDR_HS_Pos) |
			SERCOM_I2CM_ADDR_TENBITEN;
	} else {
		i2c_module->ADDR.reg = (packet->address << 1) | I2C_TRANSFER_WRITE | (packet->high_speed << SERCOM_I2CM_ADDR_HS_Pos);
//		i2c_module->ADDR.reg = (packet-> address) | I2C_TRANSFER_WRITE |	(packet->high_speed << SERCOM_I2CM_ADDR_HS_Pos);
	}
	/* Wait for response on bus. */
	tmp_status = _i2c_master_wait_for_bus(module);

	/* Check for address response error unless previous error is
	 * detected. */
	if (tmp_status == STATUS_OK) {
		tmp_status = _i2c_master_address_response(module);
	}

	if (tmp_status == STATUS_OK) {
		i2c_master_write_byte ( module, 0x00);
		i2c_master_write_byte ( module, pageByte);
		i2c_master_write_byte ( module, 0x10);
		i2c_master_write_byte ( module, 0x01);
	}
	i2c_master_send_stop(module);
	return tmp_status;
}

void gLcdShow( uint8_t * picture){
	
	uint8_t gLcdPageStart = 0xB0;
	uint8_t i, j;	

	uint8_t * picData = picture;
	 	
	i2c_packet.hs_master_code	= 0x0;
	i2c_packet.address			= ADDR_GLCD ;
	i2c_packet.data_length		= 13;
	i2c_packet.data				= gLcdInitBytes1;
	
	for( i = 0 ; i < 13 ; i++){
		gLcdPageCmd1( &i2c_master_instance, &i2c_packet, gLcdPageStart );
		gLcdDataSend( &i2c_master_instance, &i2c_packet, &picData[i*160]);
		gLcdPageStart++;
	}
}

void gLcdShow2( uint8_t * picture){
	
	uint8_t gLcdPageStart = 0xB0;
	uint8_t i, j;	

	uint8_t * picData = picture;
	 	
	i2c_packet.hs_master_code	= 0x0;
	i2c_packet.address			= ADDR_GLCD ;
	i2c_packet.data_length		= 13;
	i2c_packet.data				= gLcdInitBytes1;
	
	for( i = 13 ; i > 0 ; i--){
		gLcdPageCmd1( &i2c_master_instance, &i2c_packet, gLcdPageStart );
		gLcdDataSend( &i2c_master_instance, &i2c_packet, &picData[(i-1)*160]);
		gLcdPageStart++;
	}
}

const uint8_t picture1[2100] = {
0x00,0x00,0x00,0x00,0x00,0x00,0x00,0x00,0x00,0x00,0x00,0x00,0x00,0x00,0x00,0x00,0x00,0x00,0x00,0x00,
0x00,0x00,0x0f,0x00,0x00,0x00,0x00,0x00,0x00,0x00,0x00,0x00,0x00,0x00,0x00,0x00,0x00,0x00,0x00,0x00,
0x00,0x00,0x1f,0x80,0x00,0x00,0x00,0x00,0x00,0x00,0x00,0x00,0x00,0x00,0x00,0x00,0x00,0x00,0x00,0x00,
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0x00,0x00,0x00,0x00,0x00,0x00,0x00,0x00,0x00,0x00,0x00,0x00,0x00,0x00,0x00,0x00,0x00,0x00,0x00,0x00,

};
const uint8_t vertical[] = {
0x80, 0x80, 0x80, 0x00, 0x00, 0x80, 0x80, 0x80, 0x00, 0x00, 0x80, 0x80,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 0x00, 
0x01, 0x0f, 0x3f, 0xfc, 0xfe, 0xbf, 0x0f, 0x01, 0x00, 0x3f, 0x3f, 0x3f,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 0x00, 
0x00, 0x00, 0x00, 0x00, 0x01, 0x01, 0x01, 0x01, 0x00, 0x00, 0x00, 0x00,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 0x00, 
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0x00, 0x00, 0x00, 0x00, 0x00, 0x00, 0x00, 0x00, 0x00, 0x00, 0x00, 0x00,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 0x00, 
};
//code char vertical2[] = {
const uint8_t vertical2[] = {
0x00, 0x00, 0x00, 0x00, 0x00, 0x00, 0x00, 0x00, 0x00, 0x00, 0x00, 0x00,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 0x00, 
0x00, 0x00, 0x00, 0x00, 0x00, 0x00, 0x00, 0x00, 0x00, 0x00, 0x00, 0x00,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 0x00, 
0x00, 0x00, 0x00, 0x00, 0x00, 0x00, 0x00, 0x00, 0x00, 0x00, 0x00, 0x00,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 0x00, 
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0x00, 0x00, 0x00, 0x00, 0x00, 0x0f, 0x00, 0x00, 0x0f, 0x00, 0x03, 0x0c,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 0x00, 
};
//code char vertical3[] = {
const uint8_t vertical3[] = {
0x00, 0x00, 0x00, 0x00, 0x00, 0x00, 0x00, 0x00, 0x00, 0x00, 0x00, 0x00,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 0x00, 
0x00, 0x00, 0x00, 0x00, 0x00, 0x00, 0x00, 0x00, 0x00, 0x00, 0x00, 0x00,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 0x00, 
0x00, 0x00, 0x00, 0x00, 0x00, 0x00, 0x00, 0x00, 0x00, 0x00, 0x00, 0x00,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 0x00, 
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0x00, 0x00, 0x00, 0x00, 0x00, 0x00, 0x00, 0x00, 0x00, 0x00, 0x00, 0x00,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 0x00, 
};

// code char picture2[] = {
const uint8_t picture2[2100] = {
0xff,0xff,0xff,0xff,0xff,0xff,0xff,0xff,0xff,0xff,0xff,0xff,0xff,0xff,0xff,0xff,0xff,0xff,0xff,0xff,
0xff,0xff,0xff,0xff,0xff,0xff,0xff,0xff,0xff,0xff,0xff,0xff,0xff,0xff,0xff,0xff,0xff,0xff,0xff,0xff,
0xff,0xff,0xff,0xff,0xff,0xff,0xff,0xff,0xff,0xff,0xff,0xff,0xff,0xff,0xff,0xff,0xff,0xff,0xff,0xff,
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0xff,0xff,0xff,0xff,0xff,0xff,0xff,0xFF};

const uint8_t gLcdRunPic[] = {   
 0x00 , 0x00 , 0x00 , 0x00 , 0x40 , 0x20 , 0x11 , 0x11 , 0x09 , 0x05 , 0x03 , 0x01 , 0x01 , 0x00 , 0x00 , 0x00 , 0x00 , 0x00 , 0x00 , 0x00 , 0x00 , 0x00 , 0x00 , 0x00 , 0x00 , 0x00 , 0x00 , 0x00 , 0x00 , 0x00 , 0x01 , 0x01,
 0x00 , 0x00 , 0x00 , 0x00 , 0x00 , 0x00 , 0x00 , 0x00 , 0x00 , 0x00 , 0x00 , 0x00 , 0x00 , 0x01 , 0x01 , 0x00 , 0x00 , 0x00 , 0x00 , 0x00 , 0x00 , 0x00 , 0x00 , 0x00 , 0x00 , 0x00 , 0x00 , 0x00 , 0x00 , 0x00 , 0x00 , 0x00,
 0x00 , 0x00 , 0x00 , 0x00 , 0x00 , 0x00 , 0x00 , 0x00 , 0x00 , 0x00 , 0x00 , 0x00 , 0x00 , 0x00 , 0x00 , 0x00 , 0x00 , 0x00 , 0x00 , 0x00 , 0x00 , 0x00 , 0x00 , 0x00 , 0x00 , 0x00 , 0x00 , 0x00 , 0x00 , 0x00 , 0x00 , 0x00,
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 0x00 , 0x00 , 0x00 , 0x00 , 0x00 , 0x00 , 0x00 , 0x00 , 0x00 , 0x00 , 0x00 , 0x00 , 0x00 , 0x00 , 0x00 , 0x00 , 0x00 , 0x00 , 0x00 , 0x00 , 0x00 , 0x00 , 0x80 , 0x80 , 0x40 , 0x20 , 0x10 , 0x08 , 0x08 , 0x04 , 0x00 
};
const uint8_t gLcdStopPic[] = {   
 0x40 , 0x20 , 0x10 , 0x10 , 0x08 , 0x04 , 0x03 , 0x01 , 0x01 , 0x01 , 0x01 , 0x00 , 0x00 , 0x00 , 0x00 , 0x00 , 0x00 , 0x00 , 0x00 , 0x00 , 0x00 , 0x00 , 0x00 , 0x00 , 0x00 , 0x00 , 0x00 , 0x00 , 0x00 , 0x00 , 0x01 , 0x01,
 0x00 , 0x00 , 0x00 , 0x00 , 0x00 , 0x00 , 0x00 , 0x00 , 0x00 , 0x00 , 0x00 , 0x00 , 0x00 , 0x01 , 0x01 , 0x00 , 0x00 , 0x00 , 0x00 , 0x00 , 0x00 , 0x00 , 0x00 , 0x00 , 0x00 , 0x00 , 0x00 , 0x00 , 0x00 , 0x00 , 0x00 , 0x00,
 0x00 , 0x00 , 0x00 , 0x00 , 0x00 , 0x00 , 0x00 , 0x00 , 0x00 , 0x00 , 0x00 , 0x00 , 0x00 , 0x00 , 0x00 , 0x00 , 0x00 , 0x00 , 0x00 , 0x00 , 0x00 , 0x00 , 0x00 , 0x00 , 0x00 , 0x00 , 0x00 , 0x00 , 0x00 , 0x00 , 0x00 , 0x00,
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 0x00 , 0x00 , 0x00 , 0x00 , 0x00 , 0x00 , 0x00 , 0x00 , 0x00 , 0x00 , 0x00 , 0x00 , 0x00 , 0x00 , 0x00 , 0x00 , 0x00 , 0x00 , 0x00 , 0x00 , 0x00 , 0x00 , 0x00 , 0x80 , 0x40 , 0x40 , 0x20 , 0x00 , 0x00 , 0x00 , 0x00 
};
//--- end of file
